/dts-v1/;
/plugin/;

#include "sheng-audio-mtp.dtsi"

/ {
	model = "Qualcomm Technologies, Inc. 8550 sheng";
	compatible = "qcom,kalama-mtp\0qcom,kalama\0qcom,mtp";
	qcom,msm-id = <519 0x20000>, <519 0x10000>, <536 0x20000>, <536 0x10000>;
	qcom,board-id = <0x10008 0>;
	xiaomi,miboard-id = <0x08 0>;
};
